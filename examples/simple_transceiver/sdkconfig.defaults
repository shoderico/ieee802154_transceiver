## examples/simple_transceiver/sdkconfig.defaults
```kconfig
CONFIG_ESP32_WIFI_ENABLED=n
CONFIG_ESP32_WIFI_NVS_ENABLED=y
CONFIG_ESP32_IEEE802154_ENABLED=y
```

## test_runner/sdkconfig.defaults
```kconfig
CONFIG_ESP32_WIFI_ENABLED=n
CONFIG_ESP32_WIFI_NVS_ENABLED=y
CONFIG_ESP32_IEEE802154_ENABLED=y

CONFIG_ESP_TASK_WDT_EN=n
CONFIG_ESP_CONSOLE_USB_SERIAL_JTAG=y

CONFIG_UNITY_ENABLE_FLOAT=y
CONFIG_UNITY_ENABLE_DOUBLE=y
CONFIG_UNITY_ENABLE_COLOR=y
CONFIG_UNITY_ENABLE_IDF_TEST_RUNNER=y
```
